## general/package/encalertd/Config.in
```kconfig
config BR2_PACKAGE_ENCALERTD
	bool "encalertd"
	default y
	help
	  编码器报警守护进程（原 system_monitor bash 脚本的 C 重写版）。
	  主循环 / MQTT 上报（QoS1+spool 必达）/ 报警去重由 C 控制，
	  具体恢复动作调用 /root/encoder/actions/*.sh 小脚本。
	  设计文档见 encoder/EncoderAlertdDesign.md。
	  注意：符号名与 .mk 变量前缀必须为 ENCALERTD
	  （2026-08-31 修正，原 ENCALLOCERTD 拼写导致钩子不被识别）。
```

## general/package/encodermain/Config.in
```kconfig
config BR2_PACKAGE_ENCODERMAIN
	bool "encodermain"
	default y
	help
	  编码器主控进程（原 /root/encoder/encoder_main.sh bash 脚本群的 C 重写版）。
	  常驻 MQTT 订阅客户端 / 命令派发与幂等 / Majestic 推流录像控制 / 语音 /
	  encdb 单文件数据库（录像上传账本 + 断网重传）由 C 控制。
	  设计文档见 encoder/EncoderMainDesign.md。
	  2026-08-31 起 C 版通过大循环打包进固件（/usr/sbin/encodermain），
	  由 S96encodermain 自启；bash 版脚本群文件保留在 /root/encoder/ 下
	  （仅下线 S99zzencoder 启动服务），现场确认后再手动清理。
```
